## main/Kconfig.projbuild
```kconfig
menu "PN532 Options"
	config ENABLE_IRQ_ISR
		bool "Use IRQ pin instead of polling"
		default true
	config PN532DEBUG
		bool "Enable PN532 general debug messages"
		default false
	config MIFAREDEBUG
		bool "Enable Mifare debug messages"
		default false
	config IRQDEBUG
		bool "Enable IRQ Pin related debug messages"
		default false
endmenu

menu "Wi-Fi Configuration"

	config WIFI_SSID
		string "Wi-Fi SSID"
		default "myssid"
		help
		  Ange SSID för nätverket.
	
	config WIFI_PASSWORD
		string "Wi-Fi Password"
		default "mypassword"
		help
		  Ange lösenord för nätverket.
	
	endmenu

	menu "API Configuration"

		config API_URL
			string "API url"
			default "mmyAPIurl"
			help
			  Ange URL adressen för API anropen.
		
		config AKI_KEY
			string "API Key"
			default "myAPIkey"
			help
			  Ange API nyckeln.
		
		endmenu
```
